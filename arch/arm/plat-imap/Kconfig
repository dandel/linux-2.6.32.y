## arch/arm/plat-imap/Kconfig
```kconfig
# arch/arm/plat-imap/Kconfig
#
# Copyright (c) 2009~2014 ShangHai Infotm Ltd all rights reserved.
#
# Licensed under GPLv2

config PLAT_IMAP
	bool
	depends on ARCH_IMAP
	default y if ARCH_IMAP
	select NO_IOPORT
	select ARCH_REQUIRE_GPIOLIB
	help
	  Base platform code for any Infotm IMAP device

if PLAT_IMAP

config PLAT_IMAPX200
	bool "IMAPX200 Platform support"
	depends on ARCH_IMAP
	default y if CPU_IMAPX200
	help
	  Support for Infotm IMAPX200 CPU based systems.

config IMAP_PRODUCTION
	bool "IMAPX200 Production support"
	default n if CPU_IMAPX200
	help
	  Support for IMAPX200 Production.

config IMAP_PRODUCTION_P1011A
	bool "Support for Production Board p1011a"
	depends on IMAP_PRODUCTION && FB_IMAP_LCD1024X600
	default n

config IMAP_PRODUCTION_P1011B
	bool "Support for Production Board p1011b"
	depends on IMAP_PRODUCTION && FB_IMAP_LCD1024X600 && !IMAP_PRODUCTION_P1011A
	default n

config IMAP_PRODUCTION_P1011C
	bool "Support for Production Board p1011c"
	depends on IMAP_PRODUCTION && FB_IMAP_LCD1024X600 && !IMAP_PRODUCTION_P1011A && !IMAP_PRODUCTION_P1011B
	default n

config IMAP_PRODUCTION_P0811A
	bool "Support for Production Board p0811a"
	depends on IMAP_PRODUCTION && FB_IMAP_LCD800X600 
	default n

config IMAP_PRODUCTION_P0811B
	bool "Support for Production Board p0811b"
	depends on IMAP_PRODUCTION && FB_IMAP_LCD800X600 && !IMAP_PRODUCTION_P0811A
	default n

config IMAP_PRODUCTION_P0811C
	bool "Support for Production Board p0811c"
	depends on IMAP_PRODUCTION && FB_IMAP_LCD800X600 && !IMAP_PRODUCTION_P0811A && !IMAP_PRODUCTION_P0811B
	default n
config PANIC_DUMP
	bool "Support for production panic dump"
	depends on IMAP_PRODUCTION
	default n
config FBCON_DRAW_PANIC_TEXT
	bool "Support for production panic text"
	depends on IMAP_PRODUCTION
	default n

config IMAPX200_PWM
	bool "PWM device support"
	default y if CPU_IMAPX200
	select HAVE_PWM
	help
	  Support for exporting the PWM timer blocks via the pwm device
	  system.

config IMAPX200_DMA
	bool "IMAPX200 DMA support"
	depends on ARCH_IMAP
	help
	  IMAPX200 DMA support. This is needed for drivers like sound which
	  use the DMA system to move data to and from the peripheral blocks.

config IMAPX200_DMA_DEBUG
	bool "IMAPX200 DMA support debug"
	depends on ARCH_IMAP && IMAPX200_DMA
	help
	  Enable debugging output for the DMA code. This option sends info
	  to the kernel log, at priority KERN_DEBUG.

config IMAP_LOWLEVEL_UART_PORT
	int "IMAP UART to use for low-level messages"
	depends on PLAT_IMAP
	default 0
	help
	  Choice of which UART port to use for the low-level messages,
	  such as the `Uncompressing...` at start time. The value of
	  this configuration should be between zero and two. The port
	  must have been initialised by the boot-loader before use.

config	FAKE_PM 
	bool "Support for fake power manage"
	depends on IMAP_PRODUCTION 
	default n

comment "iMAP Settings"

menu "iMAP Reserved Memory"

config IMAP_RESERVEMEM_SIZE_ETH
	int "Memory Size Reserved for Ethernet (KB)"
	depends on ARCH_IMAP && GMAC_UNIV_ETHERNET
	default "0"
config IMAP_RESERVEMEM_SIZE_PMEM
	int "Memory Size Reserved for Android_pmem (KB)"
	depends on ARCH_IMAP && ANDROID_PMEM
	default "0"

endmenu

config IMAP_FPGA
	bool "iMAP FPGA Clock"
	depends on ARCH_IMAP
	default n
	help
	  If you are operating on the FPGA platform, say Y here!

config FPGA_EXT_CLOCK
	int "FPGA External Clock Setting"
	depends on IMAP_FPGA
	default "40000000"

endif
```

## drivers/media/camif/Kconfig
```kconfig
# Haixu Fu
#
config IMAP_CAMIF
	bool "Infotm Imapx200 camif driver"
	default n
	---help---
	This is the driver for iMapx200 camera interface,Say Y here If you
	have a imapx200 product
choice
depends on IMAP_CAMIF
prompt	"Select a camera"

config OV2655
	bool "ov2655"
config OV7670
	bool "ovc7670" 
config OV9650
	bool "ovc9650"

endchoice

config IMAP_CAMIF_DEBUG
	bool "Infotm Imapx200 debug"
	depends on IMAP_CAMIF 
	default n
	
```

## drivers/media/encode/Kconfig
```kconfig
# sololz
# never forget super mountain callage

menuconfig IMAP_ENCODE
	bool "InfoTM IMAPX200 Encode Support"
	select IMAP_MEMALLOC
	default n
	---help---
	This is a driver for InfoTM IMAPX200 Encode, includes Video, JPEG

config IMAP_ENCODE_DEBUG
	bool "print Encode Driver debug messages"
	depends on IMAP_ENCODE
	default n
```

## drivers/sensors/Kconfig
```kconfig
config SENSOR
	tristate "Orientation Sensor"
	default n
	---help---
	Say Y here if you want to use orientation sensor
```

## drivers/switch/Kconfig
```kconfig
menuconfig SWITCH
	tristate "Switch class support"
	help
	  Say Y here to enable switch class support. This allows
	  monitoring switches by userspace via sysfs and uevent.

if SWITCH

config SWITCH_GPIO
	tristate "GPIO Swith support"
	depends on GENERIC_GPIO
	help
	  Say Y here to enable GPIO based switch support.

config SWITCH_WIFI
	tristate "WIFI Swith support"
	depends on GENERIC_GPIO && (IMAP_PRODUCTION_P1011B || IMAP_PRODUCTION_P0811B)
	help
	  Say Y here to enable WIFI based switch support.

endif # SWITCH
```
